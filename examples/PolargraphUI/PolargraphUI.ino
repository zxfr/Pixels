#include <Pixels_PPI16.h>
#include <Pixels_Antialiasing.h> // optional (a removal does not impact fonts antialiasing) 
#include <Pixels_SSD1289.h>

#define null NULL

Pixels pxs(320, 240);

extern prog_uchar icon_ic_sd_storage_black_48dp_png[59] PROGMEM;
extern prog_uchar icon_ic_chat_black_24dp_png[29] PROGMEM;
extern prog_uchar icon_ic_delete_black_48dp_png_a[91] PROGMEM;
extern prog_uchar icon_ic_pause_black_48dp_png[15] PROGMEM;
extern prog_uchar icon_ic_play_arrow_black_48dp_png_a[118] PROGMEM;
extern prog_uchar icon_ic_keyboard_black_24dp_png[44] PROGMEM;
extern prog_uchar MoolBoran36ba[1347] PROGMEM;
extern prog_uchar icon_ic_backspace_black_24dp_png_a[144] PROGMEM;
extern prog_uchar icon_FontAwesomeRegular_uF00C[60] PROGMEM;
extern prog_uchar icon_FontAwesomeRegular_uF00D_a[165] PROGMEM;
extern prog_uchar icon_ic_input_black_24dp_rev_png[56] PROGMEM;
extern prog_uchar icon_ic_check_box_outline_blank_black_24dp_png[39] PROGMEM;
extern prog_uchar icon_ic_check_box_black_24dp_png_a[91] PROGMEM;
extern prog_uchar icon_ic_laptop_windows_black_24dp_png[57] PROGMEM;
extern prog_uchar icon_ic_my_location_black_24dp_png[70] PROGMEM;
extern prog_uchar icon_ic_vertical_align_top_black_24dp_png[39] PROGMEM;
extern prog_uchar icon_FontAwesomeRegular_uF040_a[226] PROGMEM;
extern prog_uchar icon_FontAwesomeRegular_uF085_a[386] PROGMEM;
extern prog_uchar icon_FontAwesomeRegular_uF0AD_a[195] PROGMEM;
extern prog_uchar icon_ic_sd_storage_black_48dp_mod_png[44] PROGMEM;
extern prog_uchar icon_ic_signal_cellular_no_sim_black_48dp_mod_png[130] PROGMEM;
extern prog_uchar icon_ic_expand_less_black_48dp_png[54] PROGMEM;
extern prog_uchar icon_ic_expand_more_black_48dp_png[54] PROGMEM;
extern prog_uchar icon_FontAwesomeRegular_uF021_a[144] PROGMEM;
extern prog_uchar Tahoma9ba[2321] PROGMEM;


	/* *************************************************************************************************
	   A sample Pixelmeister application that demonstrates various features of Pixels TFT graphics 
	   library and a way how to build a "rich UI" (to some extend) for Arduino platform.
	   
	   The application "imagines" a possible user interface for the great PolargraphSD drawing machine
	   http://www.polargraph.co.uk
	   
	   The user interface layout requires 320x240 TFT panel as an output device.
	   
	   In a compiled for Arduino form the application is about 55KB (includes all icon/font resources), 
	   which is unfortunately too much for the "classic" Arduinos. On Arduino Mega, Teensy 3.1 etc it 
	   runs great.
	   
	   You may customize the code and use it in your non-profit projects. For a commercial use please
	   contact support @ pd4ml . com
	   
	   You can support our efforts by licensing of Pixelmeister http://pd4ml.com/pixelmeister/buy.htm
	   
	   Note: the code relies on some Pixelmeister features, available starting from 20.03.2015 version
	   
	   (c)2015 pd4ml.com/pixelmeister
	************************************************************************************************* */
	
	
	
	/* *************************************************************************************************
	TEST/DEMO data section. A sequence of number pairs, simulate touchscreen events (x, y coordinates)
	If the first number is negative, a pair has a special meaning: -1, <delay>ms, -3, <progress>%, etc
	
	testPtr, testCmd[], nextCmd() are to be removed in a real-life application
	************************************************************************************************* */
	
	int testPtr = 0;
	int* testCmd = new int[2];
	
	//   int[] TEST_BATCH = { //:Pxs
	int TEST_BATCH[] = { //:Wiring
	-1, 1000,
	-4, 0,
	-1, 1000,
	-5, 0,
	-1, 1000,
	//	54, 185, // open file
	//	100, 180, // cancel
	54, 185, // open file
	270, 130,
		270, 130,
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	270, 30,
	//	270, 30,
	//	270, 30,
	//	270, 30,
	//	270, 30,
	270, 30,
	185, 200,
	-1, 1000,
	280, 200, // setup
	-1, 1000,
	300, 180, // pen setup
	-1, 1000,
	//	40, 125, // reset pen run
	//	-1, 1000,
	//	240, 180, // cancel
	40, 125, // reset pen run
	-1, 1000,
	160, 180, // ok
	-1, 1000,
	//250, 35, // edit value
	//	175, 100,
	//	220, 150,
	//	100, 200, // cancel
	//-1, 1000,
	300, 80, // edit another value
	165, 205,
	165, 205,
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	-2, 0,
	//	-1, 3000,
	//	-1, 3000,
	//	43, 86,
	//	-1, 1000,
	//	290, 204,
	//	260, 180,
	};
	
	int* nextCmd() {
		delay(200);
		testCmd[0] = TEST_BATCH[testPtr++];
		testCmd[1] = TEST_BATCH[testPtr++];
		if ( testCmd[0] == -2 ) {
			testPtr -= 2;
		}
		
	//	System.out.println(testCmd[0] + " " + testCmd[1]);
		
		return testCmd;
	}
	
	const String BLANK = "";
	
	/* *************************************************************************************************
	   TEST/DEMO SD card file list
	   to be removed in a real-life application
	************************************************************************************************* */
	
	String testFileList[] = {
		"PORTRAIT.TXT",
		"PORTRAIT.JOB",
		"MOTORBIKE.TXT",
		"SHIP.TXT",
		"SHIP.JOB",
		"ZAZ.TXT",
		"GUILLOCHES.TXT",
		BLANK,
	};
	
	/* *************************************************************************************************
	   Application constants
	************************************************************************************************* */
	
	
	const int CMD_CANCEL = 250;
	const int CMD_OK = 251;
	const int CMD_BACK = 254;
	
	const int CMD_JOB = 11;
	const int CMD_START = 12;
	const int CMD_PAUSE = 13;
	const int CMD_MOTORS_ON = 14;
	const int CMD_MOTORS_OFF = 15;
	const int CMD_SETUP = 16;
	const int CMD_JOB_INFO = 17;
	const int CMD_MACHINE_SETUP = 18;
	const int CMD_PEN_SETUP = 19;
	
	const int CMD_EDIT_SPEED = 21;
	const int CMD_EDIT_ACCELERATION = 22;
	
	const int CMD_EDIT_PEN_TIP = 23;
	const int CMD_EDIT_PEN_DROP = 24;
	const int CMD_EDIT_PEN_LIFT = 25;
	const int CMD_TEST_PEN_LIFT = 26;
	const int CMD_RESET_MILEAGE = 27;
	
	const int CMD_SET_PEN_HOME = 28;
	const int CMD_RETURN_HOME = 29;
	
	const int CMD_SAVE_STATE_NOW = 30;
	const int CMD_AUTOSAVE_ON = 31;
	const int CMD_AUTOSAVE_OFF = 32;
	const int CMD_RECALC_REMAINING = 33;
	
	const int CMD_PREV = 91;
	const int CMD_NEXT = 92;
	
	const int CMD_KEY_BACKSPACE = 93;
	const int CMD_KEY_DOT = 94;
	
	
	const int MSG_QUESTION = 1;
	const int MSG_INFO = 2;
	const int MSG_WARNING = 4;
	const int MSG_FATAL = 6;
	
	/* *************************************************************************************************
	   Predefined colors used in the application.
	   The right place to tune color model of the UI
	************************************************************************************************* */
	
	
	RGB* BACKGROUND_COLOR = new RGB(0xA6, 0xA5, 0x70);
	
	RGB* EDITFIELD_BACKGROUND_COLOR = new RGB(0x56, 0xa3, 0xFF);
	RGB* BUTTON_COLOR = new RGB(0x4F, 0x7E, 0xB7);
	
	RGB* KEYPAD_COLOR = new RGB(0x26, 0x73, 0xEC);
	//RGB* KEYPAD_COLOR = new RGB(0x4F, 0x7E, 0xB7);
	
	RGB* PROMPT_INFO_COLOR = new RGB(0x26, 0x73, 0xEC);
	RGB* PROMPT_QUESTION_COLOR = new RGB(0x26, 0x73, 0xEC);
	
	RGB* KEY_COLOR = new RGB(0x09, 0x4C, 0xB4);
	RGB* BORDER_COLOR = new RGB(0x46, 0x93, 0xFF);
	RGB* HILITE_BORDER_COLOR = new RGB(0xFF, 0x88, 0x88);
	RGB* INFO_COLOR = new RGB(0xFF, 0xFF, 0xFF);
	RGB* INFO_COLOR_SHADE0 = new RGB(0xE1, 0xE1, 0xA8);
	RGB* INFO_COLOR_SHADE1 = new RGB(0xD7, 0xD7, 0x9F);
	RGB* INFO_COLOR_SHADE2 = new RGB(0xC6, 0xC5, 0x90);
	
	//RGB* OK_COLOR = new RGB(0x00, 0x8F, 0x00);
	//RGB* OK_BORDER_COLOR = new RGB(0x20, 0xaF, 0x20);
	//RGB* CANCEL_COLOR = new RGB(0xFF, 0x68, 0x48);
	//RGB* CANCEL_BORDER_COLOR = new RGB(0xFF, 0x88, 0x88);
	
	RGB* INDICATOR_ON_COLOR = INFO_COLOR;
	RGB* INDICATOR_OFF_COLOR = new RGB(0xB6, 0xB5, 0x77);
	
	/* *************************************************************************************************
	   Application business data (Model in MVC terms) 
	************************************************************************************************* */
	boolean inProgress = false;
	boolean pcConnected = false;
	boolean sdFound = false;
	String jobCommandFile = BLANK;
	String jobStateFile = BLANK;
	boolean autoSaveState = false;
	int autosaveFreq = 20;
	int progress = 0;
	int currentStep = 0;
	int stepCount = -1;
	int elapsedTime = 0;
	int totalTime = -1;
	int penMileage = 180;
	int penDrop = 100;
	int penLift = 135;
	double penTip = 0.40;
	int motorSpeed = 800;
	int motorAcceleration = 600;
	int machineWidth = 110;
	int machineHeight = 220;
	int pageWidth = 100;
	int pageHeight = 200;
	int pageX = 10;
	int pageY = 40;
	int homeX = 50;
	int homeY = 20;
	/* end of application business data */
	
	/* *************************************************************************************************
	   TEST/DEMO job efforts estimation
	   to be replaced with reasonable code in real application
	************************************************************************************************* */
	
	void preReadJob() {
		// read number of commands from job file
		// and estimate time in seconds
		stepCount = 85345;
		totalTime = 5478;
	}
	
	
	
	/* *************************************************************************************************
	   Platform-specific implementation of utility methods 
	   In PIXELMEISTER section is Java approach; alternatively is C++
	************************************************************************************************* */
	
	#ifdef PIXELMEISTER
	int parseInt( String str ) {
		return Integer.parseInt(str);
	}
	
	double parseDouble( String str ) {
		return Double.parseDouble(str);
	}
	#else
	int parseInt( String str ) {
		return str.toInt();
	}
	double parseDouble( String str ) {
		char floatbuf[32];
		str.toCharArray(floatbuf, sizeof(floatbuf));
		return atof(floatbuf);
	}
	#endif
	
	void updateValues(); //:Wiring
	void readEditedValues(); //:Wiring
	
	void scrollLeft() {
		pxs.setBackground(BACKGROUND_COLOR);
		pxs.scroll(pxs.getWidth(), SCROLL_SMOOTH | SCROLL_CLEAN);
	}
	
	void scrollRight() {
		pxs.setBackground(BACKGROUND_COLOR);
		pxs.scroll(-pxs.getWidth(), SCROLL_SMOOTH | SCROLL_CLEAN);
	}
	
	
	/* *************************************************************************************************
	   Simple UI framework 
	   Implements basic widgets (labels, icons, buttons) as well as containters (Pane, Keypad)
	************************************************************************************************* */
	
	
	
	class Widget {
		public:
	
		prog_uchar* font;
		int left;
		int top;
		int width;
		int height;
	
		boolean hide;
		boolean dirty;
	
		virtual int event( int x, int y ) {
			return -1;
		}
	
		void setVisible( boolean visible ) {
			hide = !visible;
		}
	
		void update( int x, int y, int w, int h ) {
			if ( hide || left+width < x || x+w < left || top+height < y || y+h < top ) {
				return;
			}
			draw();
		}
	
		void update() {
			draw();
		}
	
		virtual void click() {
		}
	
		virtual void draw() {
		}
	};
	
	
	
	
	class Pane {
		public:
	
		int count;
		int size;
		RGB* backgroundColor;
		prog_uchar* font;
	
	// 	Widget[] widgets; //:Pxs
		Widget** widgets; //:Wiring
	
	// 	Pane( int numberOfWidgets, prog_uchar* defaultFont ) { //:Pxs
	// 		widgets = new Widget[numberOfWidgets]; //:Pxs
	
		Pane( int numberOfWidgets, prog_uchar defaultFont[] ) { //:Wiring
			widgets = new Widget*[numberOfWidgets]; //:Wiring
	
			backgroundColor = pxs.getBackground();
			size = numberOfWidgets;
			font = defaultFont;
			count = 0;
		}
	
	// 	virtual void add(Widget widget) { //:Pxs
	
		virtual void add(class Widget* widget) { //:Wiring
	
			if (count == size) {
				return;
			}
			widgets[count++] = widget;
			widget->font = font;
		}
	
		int event( int cmd[] ) {
			if ( -1 == cmd[0] ) {
				delay(cmd[1]);
				return -1;
			}
			return event( cmd[0], cmd[1] );
		}
	
		virtual int event( int x, int y ) {
			for ( int i = 0; i < count; i++ ) {
				int res = widgets[i]->event(x, y);
				if ( res >= 0 ) {
					return res;
				}
			}
			return -1;
		}
	
		void update( int x, int y, int w, int h ) {
			for ( int i = 0; i < count; i++ ) {
				widgets[i]->update(x, y, w, h);
			}
		}
	
		void repaint() {
			update(0, 0, pxs.getWidth(), pxs.getHeight());
		}
	
		virtual void show( boolean refresh ) {
			updateValues();
			for ( int i = 0; refresh && i < count; i++ ) {
				widgets[i]->dirty = true;
			}
			update(0, 0, pxs.getWidth(), pxs.getHeight());
		}
	};
	
	
	Pane* currentPane;
	
	
	class Label : public Widget {
		public:
	
		RGB* bgColor;
		RGB* infoColor;
		RGB* borderColor;
	
		String text;
		String oldText;
		boolean right;
	
		Label( int x, int y, int w, int h, boolean alignRight ) {
			bgColor = BACKGROUND_COLOR;
			infoColor = INFO_COLOR;
			borderColor = null;
	
			hide = false;
			dirty = false;
			text = BLANK;
			oldText = BLANK;
			font = null;
	
			left = x;
			top = y;
			width = w;
			height = h;
			right = alignRight;
		}
	
		void setText( String t ) {
			if ( text != BLANK ) {
				if ( text.equals(t) ) {
					return;
				}
				oldText = text;
			}
			text = t;
		}
	
		virtual void draw() {
			if (hide) {
				return;
			}
	
			if ( dirty ) {
				if(currentPane->backgroundColor != bgColor) {
					pxs.setColor( bgColor );
					pxs.fillRectangle(left, top, width, height);
				}
				if ( borderColor != null ) {
					pxs.setColor( borderColor );
					pxs.drawRectangle(left, top, width, height);
				}
				dirty = false;
			}
	
			if ( oldText != BLANK ) {
				pxs.setBackground( bgColor );
				pxs.setFont(font);
				if ( right ) {
					int w = pxs.getTextWidth(oldText);
					pxs.cleanText( left + width - w - pxs.getTextLineHeight()/3, top + (height-pxs.getTextLineHeight())/2, oldText);
				} else {
					pxs.cleanText( left, top + (height-pxs.getTextLineHeight())/2, oldText);
				}
				oldText = BLANK;
			}
	
			if ( text != BLANK ) {
				pxs.setColor( infoColor );
				pxs.setBackground( bgColor );
				pxs.setFont(font);
				if ( right ) {
					int w = pxs.getTextWidth(text);
					pxs.print( left + width - w - pxs.getTextLineHeight()/3, top + (height-pxs.getTextLineHeight())/2, text);
				} else {
					pxs.print( left, top + (height-pxs.getTextLineHeight())/2, text);
				}
			}
		}
	};
	
	class Icon : public Widget {
		public:
		RGB* color;
		RGB* infoColor;
		prog_uchar* icon;
		prog_uchar* oldIcon;
	
		Icon( int x, int y, int w, int h ) {
			color = BUTTON_COLOR;
			infoColor = INFO_COLOR;
			hide = false;
			dirty = false;
			icon = null;
			oldIcon = null;
			font = null;
	
			left = x;
			top = y;
			width = w;
			height = h;
		}
	
		void setIcon( prog_uchar* i ) {
			if ( icon != null ) {
				if ( icon == i ) {
					return;
				}
				oldIcon = icon;
			}
			icon = i;
		}
	
		void renderIcon( prog_uchar* i, boolean clean, int corr ) {
			int w = pxs.getIconWidth(i);
			int h = pxs.getIconHeight(i);
			pxs.setColor(infoColor);
			pxs.setBackground(color);
			if ( clean ) {
				pxs.cleanIcon( left + (width-w)/2, top + (height-h)/2 - corr, i );
			} else {
				pxs.drawIcon( left + (width-w)/2, top + (height-h)/2 - corr, i );
			}
		}
	
		virtual void draw() {
			if (hide) {
				return;
			}
	
			if ( oldIcon != null ) {
				renderIcon(oldIcon, true, 0);
				oldIcon = null;
			}
	
			if ( icon != null ) {
				renderIcon(icon, false, 0);
			}
		}
	};
	
	class Button : public Icon {
		public:
		RGB* borderColor;
		RGB* pressBorder;
	
		boolean enabled;
		int value;
		String text;
		String oldText;
	
		int corr;
	
	// 	Button( int x, int y, int width, int height, int v ) { //:Pxs
	// 		super(x, y, width, height); //:Pxs
	
		Button( int x, int y, int width, int height, int v ) : //:Wiring
			Icon(x, y, width, height) { //:Wiring
	
			borderColor = BORDER_COLOR;
			pressBorder = HILITE_BORDER_COLOR;
	
			enabled = true;
			text = BLANK;
			oldText = BLANK;
			value = v;
			corr = 0;
		}
	
		void setEnabled( boolean e ) {
			enabled = e;
		}
	
		void setText( String t ) {
			if ( text != BLANK ) {
				if ( text.equals(t) ) {
					return;
				}
				oldText = text;
			}
			text = t;
		}
	
		virtual void click() {
			if ( !hide && enabled ) {
				pxs.setColor(pressBorder);
				pxs.drawRectangle(left, top, width, height);
				delay(30);
				pxs.setColor(pressBorder);
				pxs.drawRectangle(left+1, top+1, width-2, height-2);
				delay(30);
				pxs.setColor(pressBorder);
				pxs.drawRectangle(left+2, top+2, width-4, height-4);
				delay(300);
				pxs.setColor(color);
				pxs.drawRectangle(left+1, top+1, width-2, height-2);
				pxs.drawRectangle(left+2, top+2, width-4, height-4);
				pxs.setColor(borderColor);
				pxs.drawRectangle(left, top, width, height);
			}
		}
	
		void renderText( String t, boolean clean ) {
			corr = 0;
			pxs.setColor( infoColor );
			pxs.setBackground( color );
			pxs.setFont(font);
			int w = pxs.getTextWidth(t);
			corr = pxs.getTextLineHeight() / 2;
			int y = top - corr + height - pxs.getTextLineHeight();
	
			String s = "";
			for ( int i = t.length()-1; i >= 0; i-- ) {
				char c = t.charAt(i);
				if ( c == '\n' ) {
					w = pxs.getTextWidth(s);
					if ( clean ) {
						pxs.cleanText(left + (width-w)/2, y, s);
					} else {
						pxs.print(left + (width-w)/2, y, s);
					}
					y -= pxs.getTextLineHeight();
					corr *= 2;
					s = "";
				} else {
					s = c + s;
				}
			}
			w = pxs.getTextWidth(s);
			if ( clean ) {
				pxs.cleanText(left + (width-w)/2, y, s);
			} else {
				pxs.print(left + (width-w)/2, y, s);
			}
		}
	
		virtual void draw() {
			if (hide) {
				return;
			}
	
			if ( !dirty && oldText != BLANK ) {
				renderText(oldText, true);
				oldText = BLANK;
			}
	
			if ( !dirty && oldIcon != null ) {
				renderIcon(oldIcon, true, corr);
				oldIcon = null;
			}
	
			if ( dirty ) {
				if(currentPane->backgroundColor != color) {
					pxs.setColor( color );
					pxs.fillRectangle(left, top, width, height);
				}
				pxs.setColor(borderColor);
				pxs.drawRectangle(left, top, width, height);
				dirty = false;
			}
	
			if ( text != BLANK ) {
				renderText(text, false);
			}
	
			if ( icon != null ) {
				renderIcon(icon, false, corr);
			}
		}
	
		virtual int event( int x, int y ) {
			if ( hide || !enabled ) {
				return -1;
			}
	
			if ( x >= left && x <= left+width && y >= top && y <= top+height ) {
				click();
				draw();
				return value;
			}
			return -1;
		}
	};
	
	class Key : public Button {
		public:
	
	// 	Key( int x, int y, int width, int height, int value ) { //:Pxs
	// 		super(x, y, width, height, value); //:Pxs
	
		Key( int x, int y, int width, int height, int value ) : //:Wiring
			Button(x, y, width, height, value) { //:Wiring
	
			color = KEY_COLOR;
		}
	
		void setIcon( String t, prog_uchar* f ) {
			text = t;
			font = f;
		}
	
		virtual void draw() {
			if (hide) {
				return;
			}
	
			if ( dirty ) {
				pxs.setColor(color);
				pxs.fillRectangle(left, top, width, height);
				pxs.setColor(borderColor);
				pxs.drawRectangle(left, top, width, height);
				dirty = false;
	
				if ( text != BLANK && font != null ) {
					pxs.setColor( infoColor );
					pxs.setBackground( color );
					pxs.setFont(font);
					int w = pxs.getTextWidth(text);
					int h = pxs.getTextLineHeight();
					pxs.print( left + (width-w)/2, top + (height-h)/2 + 2, text);
				}
			}
		}
	};
	
	class EditField : public Button {
	 public:
		RGB* sColor;
		RGB* sInfoColor;
	
		int scrolled;
		boolean selected;
	
	// 	EditField( int x, int y, int width, int height, int value ) { //:Pxs
	// 		super( x, y, width, height, value ); //:Pxs
	
		EditField( int x, int y, int width, int height, int value ) : //:Wiring
			Button( x, y, width, height, value ) { //:Wiring
	
			sColor = EDITFIELD_BACKGROUND_COLOR;
			sInfoColor = INFO_COLOR;
			text = "";
	
			selected = false;
			scrolled = 0;
		}
	
		void setScrolled( int scroll ) {
			scrolled = scroll;
		}
	
		virtual void click() {
			if ( !hide && enabled ) {
				selected = true;
				Button::click(); //:Wiring
	// 			super.click(); //:Pxs
			}
		}
	
		virtual void draw() {
			if (hide) {
				return;
			}
	
			pxs.setColor(selected ? infoColor : color);
			pxs.fillRectangle(left-scrolled, top, width, height);
			pxs.setColor(borderColor);
			pxs.drawRectangle(left-scrolled, top, width, height);
	
			if ( !selected && icon != null ) {
				int w = pxs.getIconWidth(icon);
				int h = pxs.getIconHeight(icon);
				pxs.setColor( infoColor );
				pxs.setBackground( color );
				pxs.drawIcon( left+width-w-2-scrolled, top+(height-h)/2, icon );
			}
	
			if ( text != BLANK ) {
				pxs.setColor(selected ? color : infoColor);
				pxs.setBackground(selected ? infoColor : color);
				pxs.setFont(font);
				int w = pxs.getTextWidth(text);
				int shift = (height-pxs.getTextLineHeight()) / 2;
				pxs.print( left+shift-scrolled, top+shift+1, text);
			}
		}
	};
	
	class ToggleButton : public Button {
		public:
	
		prog_uchar* icon1;
		prog_uchar* icon2;
		int value1;
		int value2;
		String text1;
		String text2;
	
		boolean state;
	
	// 	ToggleButton( int x, int y, int w, int h, int v1, int v2 ) { //:Pxs
	// 		super( x, y, w, h, v1 ); //:Pxs
	
		ToggleButton( int x, int y, int w, int h, int v1, int v2 ) : //:Wiring
			Button( x, y, w, h, v1 ) { //:Wiring
	
			text1 = BLANK;
			text2 = BLANK;
			icon1 = null;
			icon2 = null;
			value1 = v1;
			value2 = v2;
	
			state = true;
		}
	
		void setText( String t1, String t2 ) {
			text1 = t1;
			text2 = t2;
			Button::setText(t1); //:Wiring
	// 		setText(t1); //:Pxs
		}
	
		void setIcon( prog_uchar* i1, prog_uchar* i2 ) {
			icon1 = i1;
			icon2 = i2;
			Icon::setIcon(icon1); //:Wiring
	// 		setIcon(icon1); //:Pxs
		}
	
		virtual int event( int x, int y ) {
			if ( hide || !enabled ) {
				return -1;
			}
	
			if ( x >= left && x <= left+width && y >= top && y <= top+height ) {
				state = !state;
				if ( state ) {
					Icon::setIcon(icon1); //:Wiring
	// 				setIcon(icon1); //:Pxs
					Button::setText(text1); //:Wiring
	// 				setText(text1); //:Pxs
					value = value1;
				} else {
					Icon::setIcon(icon2); //:Wiring
	// 				setIcon(icon2); //:Pxs
					Button::setText(text2); //:Wiring
	// 				setText(text2); //:Pxs
					value = value2;
				}
				click();
				draw();
				return value;
			}
			return -1;
		}
	};
	
	class Switch : public ToggleButton {
		public:
	
	// 	Switch( int x, int y, int width, int height, int value1, int value2 ) { //:Pxs
	// 		super( x, y, width, height, value1, value2 ); //:Pxs
	
		Switch( int x, int y, int width, int height, int value1, int value2 ) : //:Wiring
			ToggleButton( x, y, width, height, value1, value2 ) { //:Wiring
	
			borderColor = color;
		}
	
		virtual void click() {
		}
	
		virtual void draw( boolean pressed, boolean refreshBackground ) {
			if (hide) {
				return;
			}
	
			if(currentPane->backgroundColor != color) {
				pxs.setColor(color);
				pxs.fillRectangle(left, top, width, height);
			}
	
			if ( icon != null ) {
				renderIcon(icon, false, 0);
			}
		}
	};
	
	class Keypad : public Pane {
		public:
	
		EditField* edit;
	
		Key* k0;
		Key* k1;
		Key* k2;
		Key* k3;
		Key* k4;
		Key* k5;
		Key* k6;
		Key* k7;
		Key* k8;
		Key* k9;
		Key* kDot;
		Button* kBS;
		Button* kOK;
		Button* kCancel;
	
		int keypadWidth;
		int scrollCorrection;
	
		String saved;
		RGB* savedBG;
	
	// 	Keypad( prog_uchar* defaultFont ) { //:Pxs
	// 		super(15, defaultFont); //:Pxs
	
		Keypad( prog_uchar* defaultFont ) : //:Wiring
			Pane(15, defaultFont) { //:Wiring
	
			edit = null;
			
			backgroundColor = KEYPAD_COLOR;
	
			keypadWidth = 190;
			scrollCorrection = pxs.getWidth() - keypadWidth;
	
			k7 = new Key( scrollCorrection + 10, 10, 50, 50, 7 );
			k7->setIcon("7", MoolBoran36ba);
			add(k7);
			k8 = new Key( scrollCorrection + 70, 10, 50, 50, 8 );
			k8->setIcon("8", MoolBoran36ba);
			add(k8);
			k9 = new Key( scrollCorrection + 130, 10, 50, 50, 9 );
			k9->setIcon("9", MoolBoran36ba);
			add(k9);
	
			k4 = new Key( scrollCorrection + 10, 67, 50, 50, 4 );
			k4->setIcon("4", MoolBoran36ba);
			add(k4);
			k5 = new Key( scrollCorrection + 70, 67, 50, 50, 5 );
			k5->setIcon("5", MoolBoran36ba);
			add(k5);
			k6 = new Key( scrollCorrection + 130, 67, 50, 50, 6 );
			k6->setIcon("6", MoolBoran36ba);
			add(k6);
	
			k1 = new Key( scrollCorrection + 10, 124, 50, 50, 1 );
			k1->setIcon("1", MoolBoran36ba);
			add(k1);
			k2 = new Key( scrollCorrection + 70, 124, 50, 50, 2 );
			k2->setIcon("2", MoolBoran36ba);
			add(k2);
			k3 = new Key( scrollCorrection + 130, 124, 50, 50, 3 );
			k3->setIcon("3", MoolBoran36ba);
			add(k3);
	
			k0 = new Key( scrollCorrection + 70, 181, 50, 50, 0 );
			k0->setIcon("0", MoolBoran36ba);
			add(k0);
	
			kDot = new Key( scrollCorrection + 130, 181, 50, 50, CMD_KEY_DOT );
			kDot->setIcon(".", MoolBoran36ba);
			add(kDot);
	
			kBS = new Button( scrollCorrection + 10, 181, 50, 50, CMD_KEY_BACKSPACE );
			kBS->color = KEY_COLOR;
			kBS->setIcon(icon_ic_backspace_black_24dp_png_a);
			add(kBS);
	
			kOK = new Button( 10, 183, 50, 50, CMD_OK );
	//		kOK->color = OK_COLOR;
	//		kOK->borderColor = OK_BORDER_COLOR;
			kOK->setIcon(icon_FontAwesomeRegular_uF00C);
			add(kOK);
	
			kCancel = new Button( 70, 183, 50, 50, CMD_CANCEL );
	//		kCancel->color = CANCEL_COLOR;
	//		kCancel->borderColor = CANCEL_BORDER_COLOR;
			kCancel->setIcon(icon_FontAwesomeRegular_uF00D_a);
			add(kCancel);
		}
	
	// 	virtual void add(Widget widget) { //:Pxs
	
		virtual void add(class Widget* widget) { //:Wiring
	
			if (count == size) {
				return;
			}
			widgets[count++] = widget;
		}
	
	// 	void show( EditField ed ) { //:Pxs
	
		void show( class EditField* ed ) { //:Wiring
	
			edit = ed;
			saved = edit->text;
	
			for ( int i = 0; i < count; i++ ) {
				widgets[i]->dirty = true;
			}
	
			savedBG = pxs.getBackground();
			pxs.setBackground(backgroundColor);
			pxs.scroll(keypadWidth, SCROLL_SMOOTH | SCROLL_CLEAN);
			edit->setScrolled(keypadWidth);
			update(scrollCorrection, 0, keypadWidth, pxs.getHeight());
			update(0, 180, scrollCorrection, 60);
		}
	
		virtual int event(int x, int y) {
			pxs.setOriginAbsolute();
			for ( int i = 0; i < count; i++ ) {
				int res = widgets[i]->event(x, y);
				if ( res < 0 ) {
					continue;
				}
				if ( res < 10 ) {
	// 				edit->text += "" + res; //:Pxs
					edit->text += String(res); //:Wiring
				} else if ( res == CMD_KEY_DOT ) {
					if ( edit->text.indexOf('.') < 0 ) {
	// 					edit->text += ".";	//:Pxs
						edit->text += String(".");	//:Wiring
					}
				} else if ( res == CMD_KEY_BACKSPACE ) {
					edit->text = edit->text.substring(0, edit->text.length() - 1);
				} else if ( res == CMD_CANCEL ) {
					edit->text = saved;
				}
				if ( res >= 0 && res < 11 || res == CMD_KEY_BACKSPACE ) {
					edit->draw();
				}
				if ( res == CMD_OK || res == CMD_CANCEL ) {
					return res;
				}
			}
			return -1;
		}
	
		void remove() {
			edit->selected = false;
			edit->draw();
			edit->setScrolled(0);
			edit = null;
	
			pxs.setBackground(savedBG);
			pxs.scroll(-keypadWidth, SCROLL_SMOOTH | SCROLL_CLEAN);
			pxs.setColor(savedBG);
			pxs.fillRectangle(200, 183, 110, 50);
		}
	};
	
	class Prompt : public Pane {
		public:
	
		Button* kCancel;
		Button* kOK;
		boolean shown;
	
		int keypadWidth;
		int scrollCorrection;
	
	// 	Prompt(prog_uchar* defaultFont) { //:Pxs
	// 		super(15, defaultFont); //:Pxs
	
		Prompt(prog_uchar* defaultFont) : //:Wiring
			Pane(15, defaultFont) { //:Wiring
	
			shown = false;
			keypadWidth = 320;
			scrollCorrection = pxs.getWidth() - keypadWidth;
	
			kOK = new Button( 140, 150, 50, 50, CMD_OK );
	//		kOK->color = OK_COLOR;
	//		kOK->borderColor = OK_BORDER_COLOR;
			kOK->setIcon(icon_FontAwesomeRegular_uF00C);
			add(kOK);
	
			kCancel = new Button( 220, 150, 50, 50, CMD_CANCEL );
	//		kCancel->color = CANCEL_COLOR;
	//		kCancel->borderColor = CANCEL_BORDER_COLOR;
			kCancel->setIcon(icon_FontAwesomeRegular_uF00D_a);
			add(kCancel);
		}
	
		void show( String text, int type ) {
			shown = true;
	
			kCancel->dirty = true;
			kOK->dirty = true;
	
			if ( (type & MSG_QUESTION) > 0 ) {
				kCancel->setVisible(true);
				pxs.setBackground(PROMPT_QUESTION_COLOR);
			} else {
				kCancel->setVisible(false);
				pxs.setBackground(PROMPT_INFO_COLOR);
			}
	
			pxs.scroll(keypadWidth, SCROLL_SMOOTH | SCROLL_CLEAN);
			update(scrollCorrection, 0, keypadWidth, pxs.getHeight());
	
			String s = "";
			int y = 110;
			int w;
			for ( int i = text.length()-1; i >= 0; i-- ) {
				char c = text.charAt(i);
				if ( c == '\n' ) {
					w = pxs.getTextWidth(s);
					pxs.print(50, y, s);
					y -= pxs.getTextLineHeight() + 3;
					s = "";
				} else {
					s = c + s;
				}
			}
			w = pxs.getTextWidth(s);
			pxs.print(50, y, s);
		}
	
		void remove() {
			shown = false;
	
			pxs.setBackground(BACKGROUND_COLOR);
			pxs.scroll(-keypadWidth, SCROLL_SMOOTH | SCROLL_CLEAN);
		}
	
	// 	void remove( Pane currentPane ) { //:Pxs
	
		void remove( class Pane* currentPane ) { //:Wiring
	
			remove();
			currentPane->show(false);
			currentPane->update(scrollCorrection, 0, keypadWidth, pxs.getHeight());
		}
	};
	
	const String CHOOSE_CAPTION = "Choose";
	const String RESUME_CAPTION = "Resume";
	
	class FileDialog : public Pane {
		public:
	
		String* files; //:Wiring
	// 	String[] files; //:Pxs
		Label** list; //:Wiring
	// 	Label[] list; //:Pxs
	
		int listPtr;
	
		Button* choose;
		Button* prevFile;
		Button* nextFile;
		Button* cancel;
	
		RGB* savedBG;
	
	// 	FileDialog(prog_uchar* defaultFont) { //:Pxs
	// 		super(15, defaultFont); //:Pxs
	
		FileDialog(prog_uchar* defaultFont) : //:Wiring
			Pane(15, defaultFont) { //:Wiring
	
			listPtr = 0;
	// 		list = new Label[7]; //:Pxs
			list = new Label*[7]; //:Wiring
	
			prevFile = new Button( 250, 15, 60, 60, CMD_PREV );
			prevFile->setIcon(icon_ic_expand_less_black_48dp_png);
			add(prevFile);
	
			nextFile = new Button( 250, 97, 60, 60, CMD_NEXT );
			nextFile->setIcon(icon_ic_expand_more_black_48dp_png);
			add(nextFile);
	
			choose = new Button( 155, 170, 60, 60, CMD_OK );
			choose->setText(CHOOSE_CAPTION);
			choose->setIcon(icon_FontAwesomeRegular_uF00C);
			add(choose);
	
			cancel = new Button( 70, 170, 60, 60, CMD_CANCEL );
			cancel->setIcon(icon_FontAwesomeRegular_uF00D_a);
			cancel->setText("Cancel");
			add(cancel);
	
			list[0] = new Label(10, 8, 210, 24, true);
			list[0]->infoColor = INFO_COLOR_SHADE2;
			add(list[0]);
	
			list[1] = new Label(10, 30, 210, 24, true);
			list[1]->infoColor = INFO_COLOR_SHADE1;
			add(list[1]);
	
			list[2] = new Label(10, 52, 210, 24, true);
			list[2]->infoColor = INFO_COLOR_SHADE0;
			add(list[2]);
	
			list[3] = new Label(70, 74, 150, 24, true);
			list[3]->borderColor = BORDER_COLOR;
			list[3]->bgColor = BUTTON_COLOR;
			add(list[3]);
	
			list[4] = new Label(10, 96, 210, 24, true);
			list[4]->infoColor = INFO_COLOR_SHADE0;
			add(list[4]);
	
			list[5] = new Label(10, 118, 210, 24, true);
			list[5]->infoColor = INFO_COLOR_SHADE1;
			add(list[5]);
	
			list[6] = new Label(10, 140, 210, 24, true);
			list[6]->infoColor = INFO_COLOR_SHADE2;
			add(list[6]);
		}
	
		void setData( String* fileList ) { //:Wiring
	// 	void setData( String[] fileList ) { //:Pxs
			files = fileList;
			listPtr = 0;
		}
	
		virtual void show(boolean refresh) {
			scrollRight();
			updateState();
			Pane::show(refresh); //:Wiring
	// 		super.show(refresh); //:Pxs
		}
	
		virtual int event(int x, int y) {
			for ( int i = 0; i < count; i++ ) {
				int res = widgets[i]->event(x, y);
				switch ( res ) {
					case CMD_PREV:
						if ( listPtr > 0 ) {
							listPtr--;
						}
						{
							boolean updateButtons = updateState();
							int areaHeight = 165;
							if ( updateButtons ) {
								areaHeight = 240;
							}
							update(150, 0, 80, areaHeight);
						}
						break;
					case CMD_NEXT:
						if ( files[listPtr+1] != BLANK ) {
							listPtr++;
						}
						{
							boolean updateButtons = updateState();
							int areaHeight = 165;
							if ( updateButtons ) {
								areaHeight = 240;
							}
							update(150, 0, 80, areaHeight);
						}
						break;
					case CMD_OK:
					case CMD_CANCEL:
						return res;
				}
			}
			return -1;
		}
	
		String getSelected() {
			return files[listPtr];
		}
	
		boolean updateState() {
			boolean exceed = false;
			for ( int i = 0; i < 7; i++ ) {
				int p = i+listPtr-3;
				if ( p >= 0 && !exceed && files[p] == BLANK ) {
					exceed = true;
				}
				if ( p < 0 || exceed ) {
					list[i]->setText(".");
				} else {
					list[i]->setText(files[p]);
				}
			}
	
			if ( getSelected().endsWith(".JOB") ) {
				if ( choose->text.equals(CHOOSE_CAPTION) ) {
					choose->setText(RESUME_CAPTION);
					return true;
				}
			} else {
				if ( choose->text.equals(RESUME_CAPTION) ) {
					choose->setText(CHOOSE_CAPTION);
					return true;
				}
			}
			return false;
		}
	};
	
	/* *************************************************************************************************
	   Application UI screen definitions 
	************************************************************************************************* */
	
	
	
	Button* backButton;
	Prompt* prompt;
	Keypad* keypad;
	
	class HomePane : public Pane {
		public:
	
		Button* jobSelectButton;
		Button* setupButton;
		ToggleButton* startButton;
		Label* jobProgressLabel;
		Button* jobInfo;
		Label* jobFileLabel;
		Icon* pcConnectIcon;
		ToggleButton* motorsButton;
	
	// 	HomePane( int[] defaultFont ) { //:Pxs
	// 		super(15, defaultFont); //:Pxs
	
		HomePane( prog_uchar* defaultFont ) : //:Wiring
			Pane(15, defaultFont) { //:Wiring
	
			pcConnectIcon = new Icon( 10, 5, 24, 24 );
			pcConnectIcon->color = BACKGROUND_COLOR;
			pcConnectIcon->setIcon(icon_ic_laptop_windows_black_24dp_png);
			add(pcConnectIcon);
	
			jobFileLabel = new Label(60, 5, 120, 24, false);
			add(jobFileLabel);
	
			jobProgressLabel = new Label(250, 5, 60, 24, true);
			jobProgressLabel->setVisible(false);
			add(jobProgressLabel);
	
			motorsButton = new ToggleButton( 10, 40, 90, 90, CMD_MOTORS_ON, CMD_MOTORS_OFF );
			motorsButton->setText("Motors ON", "Motors OFF");
			motorsButton->setIcon(icon_FontAwesomeRegular_uF085_a, icon_FontAwesomeRegular_uF085_a);
			add(motorsButton);
	
			jobInfo = new Button( 250, 40, 60, 60, CMD_JOB_INFO );
			jobInfo->setIcon(icon_ic_chat_black_24dp_png);
			jobInfo->setText("Job Info");
			add(jobInfo);
	
			jobSelectButton = new Button( 10, 140, 90, 90, CMD_JOB );
			jobSelectButton->setText("Job");
			add(jobSelectButton);
	
			startButton = new ToggleButton( 110, 140, 90, 90, CMD_START, CMD_PAUSE );
			startButton->setText("Start", "Pause");
			startButton->setIcon(icon_ic_play_arrow_black_48dp_png_a, icon_ic_pause_black_48dp_png);
			add(startButton);
	
			setupButton = new Button( 250, 170, 60, 60, CMD_SETUP );
			setupButton->setText("Setup");
			setupButton->setIcon(icon_FontAwesomeRegular_uF0AD_a);
			add(setupButton);
		}
	};
	
	class JobInfoPane : public Pane {
		public:
	
		Label* cmdFile;
		Label* progress;
		Label* step;
		Label* time;
		Label* penRun;
		Label* jobFile;
	
		Label* msl3;
		Label* msl4;
		Label* msl5;
		Label* msl6;
		Label* msl8;
		Label* l1;
		Switch* e3;
		Button* b1;
		Button* b2;
	
	// 	JobInfoPane(int[] defaultFont) { //:Pxs
	// 		super(16, defaultFont); //:Pxs
	
		JobInfoPane(prog_uchar* defaultFont) : //:Wiring
			Pane(16, defaultFont) { //:Wiring
	
			msl3 = new Label(70, 10, 120, 24, true);
			msl3->setText("Job command file");
			add(msl3);
	
			cmdFile = new Label(210, 10, 100, 24, false);
			add(cmdFile);
	
			msl4 = new Label(70, 30, 120, 24, true);
			msl4->setText("Progress");
			add(msl4);
	
			progress = new Label(210, 30, 100, 24, false);
			add(progress);
	
			msl5 = new Label(70, 50, 120, 24, true);
			msl5->setText("Step");
			add(msl5);
	
			step = new Label(210, 50, 100, 24, false);
			add(step);
	
			msl6 = new Label(70, 80, 120, 24, true);
			msl6->setText("Time elapsed / ETA");
			add(msl6);
	
			time = new Label(210, 80, 100, 24, false);
			add(time);
	
			msl8 = new Label(70, 100, 120, 24, true);
			msl8->setText("Pen run");
			add(msl8);
	
			penRun = new Label(210, 100, 100, 24, false);
			add(penRun);
	
			e3 = new Switch(210, 138, 24, 24, CMD_AUTOSAVE_OFF, CMD_AUTOSAVE_ON);
			e3->setIcon(icon_ic_check_box_outline_blank_black_24dp_png, icon_ic_check_box_black_24dp_png_a);
			add(e3);
	
			l1 = new Label(70, 130, 120, 24, true);
			l1->setText("Auto-save state as");
			add(l1);
	
			jobFile = new Label(70, 145, 120, 24, true);
			add(jobFile);
	
			b1 = new Button( 115, 181, 70, 50, CMD_SAVE_STATE_NOW );
			b1->setText("Save\nstate\nnow");
			add(b1);
	
			b2 = new Button( 210, 181, 80, 50, CMD_RECALC_REMAINING );
			b2->setText("Estimate\nremaining\ntime");
			add(b2);
	
			add(backButton);
		}
	};
	
	
	class MachineSetupPane : public Pane {
		public:
	
		EditField* speed;
		EditField* acceleration;
		Label* machineDims;
		Label* pageDims;
		Label* homePos;
		Label* pagePos;
	
		Label* msl1;
		Label* msl2;
		Label* msl3;
		Label* msl4;
		Label* msl5;
		Label* msl6;
	
		String sav;
	
	// 	MachineSetupPane(int[] defaultFont) { //:Pxs
	// 		super(15, defaultFont); //:Pxs
	
		MachineSetupPane(prog_uchar* defaultFont) : //:Wiring
			Pane(15, defaultFont) { //:Wiring
	
			msl1 = new Label(70, 25, 120, 24, true);
			msl1->setText("Motor speed");
			add(msl1);
	
			speed = new EditField(210, 25, 100, 22, CMD_EDIT_SPEED);
			speed->setIcon(icon_ic_keyboard_black_24dp_png);
			add(speed);
	
			msl2 = new Label(70, 60, 120, 24, true);
			msl2->setText("Motor acceleration");
			add(msl2);
	
			acceleration = new EditField(210, 60, 100, 22, CMD_EDIT_ACCELERATION);
			acceleration->setIcon(icon_ic_keyboard_black_24dp_png);
			add(acceleration);
	
			msl3 = new Label(70, 115, 120, 24, true);
			msl3->setText("Machine dimensions");
			add(msl3);
	
			machineDims = new Label(210, 115, 100, 24, false);
			add(machineDims);
	
			msl4 = new Label(70, 140, 120, 24, true);
			msl4->setText("Page dimensions");
			add(msl4);
	
			pageDims = new Label(210, 140, 100, 24, false);
			add(pageDims);
	
			msl5 = new Label(70, 165, 120, 24, true);
			msl5->setText("Page position");
			add(msl5);
	
			pagePos = new Label(210, 165, 100, 24, false);
			add(pagePos);
	
			msl6 = new Label(70, 190, 120, 24, true);
			msl6->setText("Home position");
			add(msl6);
	
			homePos = new Label(210, 190, 100, 24, false);
			add(homePos);
	
			add(backButton);
		}
	
		virtual int event( int x, int y ) {
			if ( keypad->edit != null ) {
				int res = keypad->event( x, y );
				switch ( res ) {
					case CMD_CANCEL:
						keypad->edit->text = sav;
						keypad->edit->draw();
						keypad->remove();
						return CMD_OK;
					case CMD_OK:
						keypad->edit->dirty = true;
						keypad->remove();
						return CMD_OK;
					default:
						if ( res >= 0 ) {
							return res;
						}
				}
			} else {
				for ( int i = 0; i < count; i++ ) {
					int res = widgets[i]->event(x, y);
					pxs.setBackground(backgroundColor);
					switch ( res ) {
						case CMD_EDIT_SPEED:
							keypad->show( speed );
							sav = keypad->edit->text;
							break;
						case CMD_EDIT_ACCELERATION:
							keypad->show( acceleration );
							sav = keypad->edit->text;
							break;
						default:
							if ( res >= 0 ) {
								return res;
							}
					}
				}
			}
			return -1;
		}
	};
	
	
	class SetupPane : public Pane {
		public:
	
		Button* setHome;
		Button* moveHome;
		Button* machineSetup;
		Button* penSetup;
	
	// 	SetupPane(int[] defaultFont) { //:Pxs
	// 		super(15, defaultFont); //:Pxs
	
		SetupPane(prog_uchar* defaultFont) : //:Wiring
			Pane(15, defaultFont) { //:Wiring
	
			setHome = new Button( 120, 40, 90, 90, CMD_SET_PEN_HOME );
			setHome->setText("Set Pen\nHome");
			setHome->setIcon(icon_ic_my_location_black_24dp_png);
			add(setHome);
	
			moveHome = new Button( 120, 140, 90, 90, CMD_RETURN_HOME );
			moveHome->setText("Move Pen\nHome");
			moveHome->setIcon(icon_ic_vertical_align_top_black_24dp_png);
			add(moveHome);
	
			machineSetup = new Button( 220, 40, 90, 90, CMD_MACHINE_SETUP );
			machineSetup->setIcon(icon_FontAwesomeRegular_uF0AD_a);
			machineSetup->setText("Machine\nSetup");
			add(machineSetup);
	
			penSetup = new Button( 220, 140, 90, 90, CMD_PEN_SETUP );
			penSetup->setText("Pen Setup");
			penSetup->setIcon(icon_FontAwesomeRegular_uF040_a);
			add(penSetup);
	
			add(backButton);
		}
	};
	
	class PenSetupPane : public Pane {
		public:
	
		EditField* penDrop;
		EditField* penLift;
		EditField* penTip;
		Label* penRun;
	
		Label* psl1;
		Label* psl2;
		Label* psl3;
		Label* psl4;
	
		Button* psb1;
		Button* psb2;
	
		String sav;
	
	// 	PenSetupPane(int[] defaultFont) { //:Pxs
	// 		super(15, defaultFont); //:Pxs
	
		PenSetupPane(prog_uchar* defaultFont) : //:Wiring
			Pane(15, defaultFont) { //:Wiring
	
			psb2 = new Button( 10, 25, 60, 60, CMD_TEST_PEN_LIFT );
			psb2->setText("Test\npen lift");
			add(psb2);
	
			psb1 = new Button( 10, 95, 60, 60, CMD_RESET_MILEAGE );
			psb1->setText("Reset\npen run");
			add(psb1);
	
			add(backButton);
	
			psl1 = new Label(70, 25, 120, 24, true);
			psl1->setText("Pen drop value");
			add(psl1);
	
			penDrop = new EditField(210, 25, 100, 22, CMD_EDIT_PEN_DROP);
			penDrop->setIcon(icon_ic_keyboard_black_24dp_png);
			add(penDrop);
	
			psl2 = new Label(70, 60, 120, 24, true);
			psl2->setText("Pen lift value");
			add(psl2);
	
			penLift = new EditField(210, 60, 100, 22, CMD_EDIT_PEN_LIFT);
			penLift->setIcon(icon_ic_keyboard_black_24dp_png);
			add(penLift);
	
			psl4 = new Label(70, 95, 120, 24, true);
			psl4->setText("Pen run, m");
			add(psl4);
	
			penRun = new Label(210, 95, 100, 24, false);
			add(penRun);
	
			psl3 = new Label(70, 130, 120, 24, true);
			psl3->setText("Pen tip, mm");
			add(psl3);
	
			penTip = new EditField(210, 130, 100, 22, CMD_EDIT_PEN_TIP);
			penTip->setIcon(icon_ic_keyboard_black_24dp_png);
			add(penTip);
		}
	
		virtual int event( int x, int y ) {
	
			if ( keypad->edit != null ) {
				int res = keypad->event( x, y );
				switch ( res ) {
					case CMD_CANCEL:
						keypad->edit->text = sav;
						keypad->edit->draw();
						keypad->remove();
						return CMD_OK;
					case CMD_OK:
						keypad->edit->dirty = true;
						keypad->remove();
						return CMD_OK;
					default:
						if ( res >= 0 ) {
							return res;
						}
				}
			} else if ( prompt->shown ) {
				int res = prompt->event( x, y );
				switch ( res ) {
					case CMD_CANCEL:
						prompt->remove();
						return CMD_OK;
					case CMD_OK:
						penMileage = 0;
						prompt->remove();
						return CMD_OK;
				}
			} else {
				for ( int i = 0; i < count; i++ ) {
					int res = widgets[i]->event(x, y);
					pxs.setBackground(backgroundColor);
					switch ( res ) {
						case CMD_EDIT_PEN_TIP:
							keypad->show( penTip );
							sav = keypad->edit->text;
							break;
						case CMD_EDIT_PEN_LIFT:
							keypad->show( penLift );
							sav = keypad->edit->text;
							break;
						case CMD_EDIT_PEN_DROP:
							keypad->show( penDrop );
							sav = keypad->edit->text;
							break;
						case CMD_RESET_MILEAGE:
							prompt->show("PEN RUN RESET\n\nIt's expected a new pen is installed.\nProceed with the old pen statistics reset?", MSG_QUESTION | MSG_FATAL);
							break;
						default:
							if ( res >= 0 ) {
								return res;
							}
					}
				}
			}
			return -1;
		}
	};
	
	HomePane* homePane;
	JobInfoPane* jobInfoPane;
	SetupPane* setupPane;
	PenSetupPane* penSetupPane;
	MachineSetupPane* machineSetupPane;
	FileDialog* fileSelectPane;
	
	
	/* *************************************************************************************************
	   "Data model <--> UI" exchange code 
	************************************************************************************************* */
	
	
	void readEditedValues() {
		if (machineSetupPane->speed->dirty) {
			motorSpeed = parseInt(machineSetupPane->speed->text);
			machineSetupPane->speed->dirty = false;
		}
		if (machineSetupPane->acceleration->dirty) {
			motorAcceleration = parseInt(machineSetupPane->acceleration->text);
			machineSetupPane->acceleration->dirty = false;
		}
		if (penSetupPane->penLift->dirty) {
			penLift = parseInt(penSetupPane->penLift->text);
			penSetupPane->penLift->dirty = false;
		}
		if (penSetupPane->penDrop->dirty) {
			penDrop = parseInt(penSetupPane->penDrop->text);
			penSetupPane->penDrop->dirty = false;
		}
		if (penSetupPane->penTip->dirty) {
			penTip = parseDouble(penSetupPane->penTip->text);
			penSetupPane->penTip->dirty = false;
		}
	}
	
	void updateValues() {
		if ( pcConnected ) {
			homePane->pcConnectIcon->infoColor = INFO_COLOR;
		} else {
			homePane->pcConnectIcon->infoColor = INDICATOR_OFF_COLOR;
		}
		if (jobCommandFile==BLANK) {
			homePane->jobFileLabel->setText("No Job File Selected");
			homePane->jobFileLabel->infoColor = INDICATOR_OFF_COLOR;
			homePane->jobInfo->setVisible(false);
			homePane->startButton->setVisible(false);
			homePane->jobProgressLabel->setVisible(false);
		} else {
			homePane->jobFileLabel->setText(jobCommandFile);
			homePane->jobFileLabel->infoColor = INFO_COLOR;
			homePane->jobInfo->setVisible(true);
			homePane->startButton->setVisible(true);
			homePane->jobProgressLabel->setVisible(true);
	
			int secs = (elapsedTime%60);
	
	#ifdef PIXELMEISTER
			String elapsed = (elapsedTime/60) + ":" + (secs < 10 ? "0" : "") + secs;
			String eta;
			if ( totalTime < 0 ) {
				eta = "?";
			} else {
				int t = totalTime - elapsedTime;
				secs = (t%60);
				eta = (t/60) + ":" + (secs < 10 ? "0" : "") + secs;
			}
			jobInfoPane->time->setText(elapsed + " / " + eta);
			if ( stepCount < 0 ) {
				jobInfoPane->step->setText(currentStep + " of ?");
			} else {
				jobInfoPane->step->setText(currentStep + " of " + stepCount);
			}
			jobInfoPane->penRun->setText(penMileage +" m");
			jobInfoPane->progress->setText(progress + "%");
	
	#else
			String elapsed = String(elapsedTime/60) + ":" + (secs < 10 ? "0" : "") + String(secs);
			String eta;
			if ( totalTime < 0 ) {
				eta = "?";
			} else {
				int t = totalTime - elapsedTime;
				secs = (t%60);
				eta = String(t/60) + ":" + (secs < 10 ? "0" : "") + String(secs);
			}
			jobInfoPane->time->setText(String(elapsed) + " / " + String(eta));
			if ( stepCount < 0 ) {
				jobInfoPane->step->setText(String(currentStep) + " of ?");
			} else {
				jobInfoPane->step->setText(String(currentStep) + " of " + String(stepCount));
			}
			jobInfoPane->penRun->setText(String(penMileage) +" m");
			jobInfoPane->progress->setText(String(progress) + "%");
	#endif
	
			jobInfoPane->cmdFile->setText(jobCommandFile);
			int ind = jobCommandFile.indexOf('.');
			jobStateFile = jobCommandFile.substring(0, ind) + ".JOB";
			jobInfoPane->jobFile->setText(jobStateFile);
		}
		if ( sdFound ) {
			homePane->jobSelectButton->setIcon(icon_ic_sd_storage_black_48dp_mod_png);
		} else {
			homePane->jobSelectButton->setIcon(icon_ic_signal_cellular_no_sim_black_48dp_mod_png);
		}
	
	#ifdef PIXELMEISTER
		homePane->jobProgressLabel->setText(progress + "%");
	
		penSetupPane->penTip->setText(""+penTip);
		penSetupPane->penDrop->setText(""+penDrop);
		penSetupPane->penLift->setText(""+penLift);
		penSetupPane->penRun->setText(""+penMileage);
	
		machineSetupPane->speed->setText(""+motorSpeed);
		machineSetupPane->acceleration->setText(""+motorAcceleration);
		machineSetupPane->machineDims->setText(machineWidth + "x" + machineHeight + " mm");
		machineSetupPane->pageDims->setText(pageWidth + "x" + pageHeight + " mm");
		machineSetupPane->pagePos->setText(pageX + ", " + pageY + " mm");
		machineSetupPane->homePos->setText(homeX + ", " + homeY + " mm");
	#else
		homePane->jobProgressLabel->setText(String(progress) + "%");
	
		char buf[10]; // needs to be at least large enough to fit the formatted text
		dtostrf(penTip, 4, 2, buf);
	
		penSetupPane->penTip->setText(String(buf));
		penSetupPane->penDrop->setText(String(penDrop));
		penSetupPane->penLift->setText(String(penLift));
		penSetupPane->penRun->setText(String(penMileage));
	
		machineSetupPane->speed->setText(String(motorSpeed));
		machineSetupPane->acceleration->setText(String(motorAcceleration));
		machineSetupPane->machineDims->setText(String(machineWidth) + "x" + String(machineHeight) + " mm");
		machineSetupPane->pageDims->setText(String(pageWidth) + "x" + String(pageHeight) + " mm");
		machineSetupPane->pagePos->setText(String(pageX) + ", " + String(pageY) + " mm");
		machineSetupPane->homePos->setText(String(homeX) + ", " + String(homeY) + " mm");
	#endif
	
	}
	
	/* *************************************************************************************************
	   Font and image resources, referenced from the application UI
	************************************************************************************************* */
	
	
	// int[] icon_ic_sd_storage_black_48dp_png = { //:Pxs


	void setup() {
		
		pxs.init();
		// The section is to be exported as setup() method
		// Automatically recognized by "Sketch export module" of Pixelmeister
		
		pxs.setOriginAbsolute();
		
		pxs.setBackground(BACKGROUND_COLOR);
		pxs.clear();
		
		backButton = new Button( 10, 183, 50, 50, CMD_BACK );
		backButton->setIcon(icon_ic_input_black_24dp_rev_png);
		backButton->setText("Back");
		
		homePane = new HomePane(Tahoma9ba);
		jobInfoPane = new JobInfoPane(Tahoma9ba);
		setupPane = new SetupPane(Tahoma9ba);
		penSetupPane = new PenSetupPane(Tahoma9ba);
		machineSetupPane = new MachineSetupPane(Tahoma9ba);
		fileSelectPane = new FileDialog(Tahoma9ba);
		prompt = new Prompt(Tahoma9ba);
		keypad = new Keypad(Tahoma9ba);
		
		updateValues();
		
		currentPane = homePane;
		currentPane->show(true);
		
		
		// End of setup() code
		// the remaining goes to loop() method

	}

	void loop() {
		/* *************************************************************************************************
		   A sample Pixelmeister application that demonstrates various features of Pixels TFT graphics 
		   library and a way how to build a "rich UI" (to some extend) for Arduino platform.
		   
		   The application "imagines" a possible user interface for the great PolargraphSD drawing machine
		   http://www.polargraph.co.uk
		   
		   The user interface layout requires 320x240 TFT panel as an output device.
		   
		   In a compiled for Arduino form the application is about 55KB (includes all icon/font resources), 
		   which is unfortunately too much for the "classic" Arduinos. On Arduino Mega, Teensy 3.1 etc it 
		   runs great.
		   
		   You may customize the code and use it in your non-profit projects. For a commercial use please
		   contact support @ pd4ml . com
		   
		   You can support our efforts by licensing of Pixelmeister http://pd4ml.com/pixelmeister/buy.htm
		   
		   Note: the code relies on some Pixelmeister features, available starting from 20.03.2015 version
		   
		   (c)2015 pd4ml.com/pixelmeister
		************************************************************************************************* */
		
                             
                                                  
                                                                     

                        

                                    
            

                                                     
                                                      
                            

                                   
                                         
                                     
                                           
                                                   
                                           
                               
                               

               

                       
                        


                      
                                      
		
		
		
		do {
			// read next command from the test data array.
			// in real application it should read data from touchscreen and application model
			
		// 	int[] cmd = nextCmd(); //:Pxs
		int* cmd = nextCmd(); //:Wiring
		
			if ( cmd[0] < 0 ) { // for debug/test/demo purposes
				boolean done = false;
				switch(cmd[0]) {
					case -1: // delay (the case is to be removed in a real-life application)
						delay( cmd[1] );
						break;
					case -2: // quit (the case is to be removed in a real-life application)
						done = true;
						break;
					case -3: // progress update
						progress = cmd[1];
						updateValues();
						currentPane->show(false);
						break;
					case -4: // PC connected
						pcConnected = true;
						updateValues();
						homePane->pcConnectIcon->update();
						break;
					case -5: // SD found
						sdFound = true;
						updateValues();
						homePane->jobSelectButton->update();
						break;
					case -6: // steps update
						currentStep = cmd[1];
						updateValues();
						currentPane->show(false);
						break;
				}
				if ( done ) {
					break;
				}
				continue;
			}
		
			// "Controller" in MVC terms
			//
			// Partially controller logic is implemented in particular screen definitions
			// (containters, derived from Pane class) - go "Resources and Functions" tab
			
			int res = currentPane->event( cmd );
			switch ( res ) {
				case CMD_CANCEL:
					if ( currentPane == fileSelectPane ) {
						scrollLeft();
						currentPane = homePane;
						currentPane->show(true);
					}
					break;
				case CMD_OK:
					if ( currentPane == fileSelectPane ) {
						scrollLeft();
						jobCommandFile = fileSelectPane->getSelected();
						currentPane = homePane;
						currentPane->show(true);
					}
					if ( currentPane == penSetupPane || currentPane == machineSetupPane ) {
						readEditedValues();
						currentPane->show(true);
					}
					break;
				case CMD_BACK:
					if ( currentPane == setupPane || currentPane == jobInfoPane ) {
						scrollRight();
						currentPane = homePane;
						currentPane->show(true);
					} else if ( currentPane == penSetupPane || currentPane == machineSetupPane ) {
						scrollRight();
						currentPane = setupPane;
						currentPane->show(true);
					}
					break;
		
				case CMD_JOB:
					fileSelectPane->setData(testFileList);
					currentPane = fileSelectPane;
					currentPane->show(true);
					break;
				case CMD_START:
					// pen down if needed
					// run/resume job
					break;
				case CMD_PAUSE:
					// pen up
					// pause job
					break;
				case CMD_MOTORS_ON:
					// power on the motors
					break;
				case CMD_MOTORS_OFF:
					// power off the motors
					break;
				case CMD_SETUP:
					scrollLeft();
					currentPane = setupPane;
					currentPane->show(true);
					break;
				case CMD_MACHINE_SETUP:
					scrollLeft();
					currentPane = machineSetupPane;
					currentPane->show(true);
					break;
				case CMD_PEN_SETUP:
					scrollLeft();
					currentPane = penSetupPane;
					currentPane->show(true);
					break;
				case CMD_SET_PEN_HOME:
					// tells machine, that the current pen position matches HOME
					break;
				case CMD_RETURN_HOME:
					// lift pen up and moves pen HOME
					break;
				case CMD_TEST_PEN_LIFT:
					// do pen lift test here
					break;
				case CMD_JOB_INFO:
					scrollLeft();
					currentPane = jobInfoPane;
					currentPane->show(true);
					break;
				case CMD_AUTOSAVE_ON:
					// enable a save of .JOB file let's say each 50 steps done
					break;
				case CMD_AUTOSAVE_OFF:
					// disable autosave
					break;
				case CMD_SAVE_STATE_NOW:
					// force save .JOB file
					// .JOB file includes a name of .TXT file with draw commands
					// total number of steps, current step number etc
					break;
				case CMD_RECALC_REMAINING:
					preReadJob();
					currentPane->show(false);
					break;
			}
		} while ( 1 );
		
		// pxs.fontStatistics(); //:Pxs
		// delay(2000); //:Pxs
	}

	prog_uchar icon_ic_sd_storage_black_48dp_png[59] PROGMEM = { //:Wiring
	0x5A,0x62,0x00,0x3B,0x30,0x30,0x88,0x04,0x84,0x0B,0x9C,0x0B,0x9E,0x09,0x9F,0x08,0xA0,0x07,0xA1,0x06,
	0xA2,0x05,0xA3,0x04,0xA4,0x03,0xA5,0x02,0xA6,0x01,0xD3,0x08,0xA0,0x08,0xA0,0x08,0xA0,0x08,0xF0,0x08,
	0xA0,0x08,0xA0,0x08,0xA0,0x08,0xF0,0x08,0xA0,0x08,0xA0,0x08,0xA0,0x08,0xFF,0x95,0x01,0xA6,0x01,};
	/*
	array size:   59
	image size:   48x48
	usage:
		pxs.drawIcon(x, y, icon_ic_sd_storage_black_48dp_png);
		pxs.cleanIcon(x, y, icon_ic_sd_storage_black_48dp_png);
	*/
	// int[] icon_ic_chat_black_24dp_png = { //:Pxs
	 prog_uchar icon_ic_chat_black_24dp_png[29] PROGMEM = { //:Wiring
	0x5A,0x62,0x00,0x1D,0x18,0x18,0x02,0x02,0x82,0xD4,0x0C,0x88,0x0C,0x9C,0x0C,0x88,0x0C,0x9C,0x08,0x8C,
	0x08,0xDC,0x10,0x83,0x11,0x82,0x12,0x81,0x13,};
	/*
	array size:   29
	image size:   24x24
	usage:
		pxs.drawIcon(x, y, icon_ic_chat_black_24dp_png);
		pxs.cleanIcon(x, y, icon_ic_chat_black_24dp_png);
	*/
	// int[] icon_ic_delete_black_48dp_png_a = { //:Pxs
	 prog_uchar icon_ic_delete_black_48dp_png_a[91] PROGMEM = { //:Wiring
	0x5A,0x61,0x00,0x5B,0x30,0x30,0x0A,0x06,0x0A,0x48,0x1F,0x8A,0x1F,0x4F,0x1F,0x8C,0x1F,0x47,0xBF,0xB1,
	0x7A,0x98,0x44,0x98,0x44,0x98,0x44,0x98,0x44,0x98,0x44,0x98,0x44,0x98,0x44,0x98,0x44,0x98,0x44,0x98,
	0x44,0x98,0x44,0x98,0x44,0x98,0x44,0x98,0x44,0x98,0x44,0x98,0x44,0x98,0x44,0x98,0x44,0x98,0x44,0x98,
	0x44,0x98,0x44,0x98,0x44,0x98,0x44,0x98,0x44,0x02,0x96,0x03,0x44,0x13,0x96,0x14,0x44,0x35,0x03,0x94,
	0x04,0x36,0x45,0x35,0x13,0x03,0x90,0x03,0x14,0x36,0x43,};
	/*
	array size:   91
	image size:   48x48
	usage:
		pxs.drawIcon(x, y, icon_ic_delete_black_48dp_png_a);
		pxs.cleanIcon(x, y, icon_ic_delete_black_48dp_png_a);
	*/
	// int[] icon_ic_pause_black_48dp_png = { //:Pxs
	 prog_uchar icon_ic_pause_black_48dp_png[15] PROGMEM = { //:Wiring
	0x5A,0x62,0x00,0x0F,0x30,0x30,0x8C,0x0A,0x8A,0xFF,0xE1,0x7F,0x61,0xFF,0xE1,};
	/*
	array size:   15
	image size:   48x48
	usage:
		pxs.drawIcon(x, y, icon_ic_pause_black_48dp_png);
		pxs.cleanIcon(x, y, icon_ic_pause_black_48dp_png);
	*/
	// int[] icon_ic_play_arrow_black_48dp_png_a = { //:Pxs
	 prog_uchar icon_ic_play_arrow_black_48dp_png_a[118] PROGMEM = { //:Wiring
	0x5A,0x61,0x00,0x76,0x30,0x30,0x90,0x0A,0x0A,0x14,0x9A,0x14,0x39,0x03,0x98,0x03,0x39,0x41,0x25,0x98,
	0x26,0x42,0x3F,0x0F,0x96,0x0F,0x3F,0x43,0x35,0x01,0x94,0x01,0x35,0x45,0x1F,0x94,0x20,0x46,0x3E,0x0A,
	0x92,0x0A,0x3E,0x47,0x31,0x00,0x90,0x00,0x31,0x49,0x1A,0x90,0x1A,0x4A,0x3C,0x06,0x8E,0x06,0x3C,0x4B,
	0x2B,0x8E,0x2B,0x4D,0x14,0x8C,0x14,0x4E,0x39,0x03,0x8A,0x03,0x39,0x4F,0x25,0x8A,0x26,0x50,0x3F,0x0F,
	0x88,0x0F,0x3F,0x51,0x35,0x01,0x86,0x01,0x35,0x53,0x1F,0x86,0x20,0x54,0x3E,0x0A,0x84,0x0A,0x3E,0x55,
	0x31,0x00,0x82,0x00,0x31,0x57,0x1A,0x82,0x1A,0x58,0x3C,0x06,0x06,0x3C,0x59,0x2B,0x2B,0x4D,};
	/*
	array size:   118
	image size:   48x48
	usage:
		pxs.drawIcon(x, y, icon_ic_play_arrow_black_48dp_png_a);
		pxs.cleanIcon(x, y, icon_ic_play_arrow_black_48dp_png_a);
	*/
	// int[] icon_ic_keyboard_black_24dp_png = { //:Pxs
	 prog_uchar icon_ic_keyboard_black_24dp_png[44] PROGMEM = { //:Wiring
	0x5A,0x62,0x00,0x2C,0x18,0x18,0x02,0x05,0x02,0x80,0x00,0x10,0x00,0x00,0x00,0x00,0x01,0xB6,0xD8,0x1B,
	0x6D,0x80,0x00,0x00,0x1B,0x6D,0x81,0xB6,0xD8,0x00,0x00,0x00,0x00,0x00,0x03,0xFC,0x00,0x3F,0xC0,0x00,
	0x00,0x08,0x00,0x01,};
	/*
	array size:   44
	image size:   24x24
	usage:
		pxs.drawIcon(x, y, icon_ic_keyboard_black_24dp_png);
		pxs.cleanIcon(x, y, icon_ic_keyboard_black_24dp_png);
	*/
	
	// int[] MoolBoran36ba = { //:Pxs
	 prog_uchar MoolBoran36ba[1347] PROGMEM = { //:Wiring
	0x5A,0x46,0x02,0x19,0x22,0x00,0x33,0x00,0x9A,0x14,0x01,0x01,0x03,0x42,0x2A,0x16,0x0D,0x03,0x01,0x01,
	0x02,0x05,0x13,0x1F,0x35,0x44,0x3F,0x00,0x8A,0x1C,0x43,0x36,0x8C,0x25,0x42,0x2B,0x01,0x16,0x2A,0x3A,
	0x41,0x3C,0x2A,0x07,0x84,0x0B,0x42,0x38,0x3D,0x46,0x33,0x84,0x01,0x4B,0x84,0x03,0x4A,0x38,0x84,0x19,
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	0x26,0x28,0x43,0x00,0x00,0x00,0x00,};
	// antialiased
	// array size:   1347
	// glyph height: 99
	// baseline:     34
	// range:        .#00048-#00057
	/* usage:
		pxs.setFont(MoolBoran36ba);
		pxs.print(x, y, "...");
	*/
	
	// int[] icon_ic_backspace_black_24dp_png_a = { //:Pxs
	 prog_uchar icon_ic_backspace_black_24dp_png_a[144] PROGMEM = { //:Wiring
	0x5A,0x61,0x00,0x90,0x18,0x18,0x80,0x03,0x03,0x47,0x3A,0x15,0x15,0x3A,0x4D,0x2A,0x05,0x82,0x05,0x2A,
	0x4A,0x3A,0x14,0x86,0x15,0x3A,0x47,0x2A,0x05,0x88,0x05,0x2A,0x44,0x3A,0x14,0x8C,0x15,0x3A,0x41,0x2E,
	0x04,0x8E,0x05,0x2E,0x05,0x90,0x06,0xA8,0x0B,0x2F,0x05,0x84,0x05,0x2F,0x0B,0x88,0x2F,0x41,0x34,0x05,
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	0x05,0x8E,0x05,0x2C,};
	/*
	array size:   144
	image size:   24x24
	usage:
		pxs.drawIcon(x, y, icon_ic_backspace_black_24dp_png_a);
		pxs.cleanIcon(x, y, icon_ic_backspace_black_24dp_png_a);
	*/
	
	// int[] icon_FontAwesomeRegular_uF00C = { //:Pxs
	 prog_uchar icon_FontAwesomeRegular_uF00C[60] PROGMEM = { //:Wiring
	0x5A,0x62,0x00,0x3C,0x15,0x1E,0x02,0x00,0x82,0x2F,0x82,0x17,0x84,0x15,0x86,0x13,0x88,0x11,0x89,0x10,
	0x89,0x04,0x82,0x0A,0x89,0x04,0x84,0x08,0x89,0x04,0x86,0x06,0x89,0x04,0x88,0x04,0x89,0x05,0x89,0x02,
	0x89,0x07,0x92,0x09,0x90,0x0B,0x8E,0x0D,0x8C,0x0F,0x8A,0x11,0x88,0x13,0x86,0x15,0x84,0x17,0x82,0x15,
	};
	/*
	array size:   60
	image size:   30x21
	usage:
		pxs.drawIcon(x, y, icon_FontAwesomeRegular_uF00C);
		pxs.cleanIcon(x, y, icon_FontAwesomeRegular_uF00C);
	*/
	// int[] icon_FontAwesomeRegular_uF00D_a = { //:Pxs
	 prog_uchar icon_FontAwesomeRegular_uF00D_a[165] PROGMEM = { //:Wiring
	0x5A,0x61,0x00,0xA5,0x15,0x18,0x01,0x00,0x02,0x43,0x39,0x1C,0x2A,0x49,0x3B,0x1D,0x24,0x45,0x38,0x07,
	0x82,0x22,0x47,0x3A,0x0B,0x82,0x1A,0x43,0x38,0x07,0x84,0x22,0x45,0x3A,0x0B,0x84,0x1A,0x41,0x3F,0x07,
	0x86,0x22,0x43,0x3A,0x0B,0x86,0x22,0x3D,0x88,0x22,0x41,0x3A,0x0B,0x87,0x15,0x41,0x1A,0x88,0x1F,0x0B,
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	0x3A,0x4A,0x31,0x37,0x43,};
	/*
	array size:   165
	image size:   24x21
	usage:
		pxs.drawIcon(x, y, icon_FontAwesomeRegular_uF00D_a);
		pxs.cleanIcon(x, y, icon_FontAwesomeRegular_uF00D_a);
	*/
	
	// int[] icon_ic_input_black_24dp_rev_png = { //:Pxs
	 prog_uchar icon_ic_input_black_24dp_rev_png[56] PROGMEM = { //:Wiring
	0x5A,0x62,0x00,0x38,0x18,0x18,0x01,0x03,0x81,0x01,0x94,0x01,0x98,0x12,0x84,0x12,0x84,0x12,0x84,0x09,
	0x81,0x08,0x84,0x08,0x82,0x0A,0x82,0x07,0x83,0x0A,0x82,0x06,0x90,0x06,0x90,0x07,0x83,0x0A,0x82,0x08,
	0x82,0x0A,0x82,0x09,0x81,0x08,0x84,0x12,0x84,0x12,0x84,0x12,0x98,0x01,0x94,0x05,};
	/*
	array size:   56
	image size:   24x24
	usage:
		pxs.drawIcon(x, y, icon_ic_input_black_24dp_rev_png);
		pxs.cleanIcon(x, y, icon_ic_input_black_24dp_rev_png);
	*/
	// int[] icon_ic_check_box_outline_blank_black_24dp_png = { //:Pxs
	 prog_uchar icon_ic_check_box_outline_blank_black_24dp_png[39] PROGMEM = { //:Wiring
	0x5A,0x62,0x00,0x27,0x18,0x18,0x03,0x03,0x83,0xA6,0x0E,0x84,0x0E,0x84,0x0E,0x84,0x0E,0x84,0x0E,0x84,
	0x0E,0x84,0x0E,0x84,0x0E,0x84,0x0E,0x84,0x0E,0x84,0x0E,0x84,0x0E,0x84,0x0E,0x84,0x0E,0xA6,0x04,};
	/*
	array size:   39
	image size:   24x24
	usage:
		pxs.drawIcon(x, y, icon_ic_check_box_outline_blank_black_24dp_png);
		pxs.cleanIcon(x, y, icon_ic_check_box_outline_blank_black_24dp_png);
	*/
	// int[] icon_ic_check_box_black_24dp_png_a = { //:Pxs
	 prog_uchar icon_ic_check_box_black_24dp_png_a[91] PROGMEM = { //:Wiring
	0x5A,0x61,0x00,0x5B,0x18,0x18,0x03,0x03,0x03,0x2B,0x05,0x8E,0x05,0x2B,0x05,0x90,0x05,0xA0,0x0B,0x90,
	0x16,0x3F,0x1F,0x8E,0x16,0x3F,0x41,0x1F,0x8D,0x16,0x3F,0x41,0x1F,0x86,0x0B,0x86,0x16,0x3F,0x41,0x1F,
	0x86,0x20,0x3F,0x16,0x84,0x16,0x3F,0x41,0x1F,0x87,0x1F,0x41,0x3F,0x16,0x82,0x16,0x3F,0x41,0x1F,0x89,
	0x1F,0x41,0x3F,0x16,0x16,0x3F,0x41,0x1F,0x8B,0x1F,0x41,0x3F,0x3F,0x41,0x1F,0x8D,0x1F,0x42,0x1F,0x8F,
	0x1F,0x1F,0xAE,0x05,0x90,0x05,0x2B,0x05,0x8E,0x05,0x2C,};
	/*
	array size:   91
	image size:   24x24
	usage:
		pxs.drawIcon(x, y, icon_ic_check_box_black_24dp_png_a);
		pxs.cleanIcon(x, y, icon_ic_check_box_black_24dp_png_a);
	*/
	// int[] icon_ic_laptop_windows_black_24dp_png = { //:Pxs
	 prog_uchar icon_ic_laptop_windows_black_24dp_png[57] PROGMEM = { //:Wiring
	0x5A,0x62,0x00,0x39,0x18,0x18,0x80,0x03,0x84,0x0F,0x82,0x0F,0x90,0x01,0x90,0x01,0x84,0x0A,0x87,0x0A,
	0x87,0x0A,0x87,0x0A,0x87,0x0A,0x87,0x0A,0x87,0x0A,0x87,0x0A,0x87,0x0A,0x87,0x0A,0x87,0x0A,0x87,0x0A,
	0x87,0x0A,0x87,0x0A,0x87,0x0A,0x87,0x0A,0x93,0x01,0x90,0x01,0x82,0x0F,0x82,0x0F,0x82,};
	/*
	array size:   57
	image size:   24x24
	usage:
		pxs.drawIcon(x, y, icon_ic_laptop_windows_black_24dp_png);
		pxs.cleanIcon(x, y, icon_ic_laptop_windows_black_24dp_png);
	*/
	
	// int[] icon_ic_my_location_black_24dp_png = { //:Pxs
	 prog_uchar icon_ic_my_location_black_24dp_png[70] PROGMEM = { //:Wiring
	0x5A,0x62,0x00,0x46,0x18,0x18,0x01,0x01,0x01,0xFF,0xCF,0xFF,0xFF,0x3F,0xFF,0xF0,0x3F,0xFF,0x00,0x3F,
	0xF8,0x78,0x7F,0xC7,0xF8,0xFE,0x3F,0xF1,0xF9,0xE1,0xE7,0xC7,0x03,0x8F,0x38,0x07,0x30,0xE0,0x1C,0x03,
	0x80,0x70,0xCE,0x01,0xCF,0x1C,0x0E,0x3E,0x78,0x79,0xF8,0xFF,0xC7,0xF1,0xFE,0x3F,0xE1,0xE1,0xFF,0xC0,
	0x0F,0xFF,0xC0,0xFF,0xFF,0xCF,0xFF,0xFF,0x3F,0xFF,};
	/*
	array size:   70
	image size:   24x24
	usage:
		pxs.drawIcon(x, y, icon_ic_my_location_black_24dp_png);
		pxs.cleanIcon(x, y, icon_ic_my_location_black_24dp_png);
	*/
	
	// int[] icon_ic_vertical_align_top_black_24dp_png = { //:Pxs
	 prog_uchar icon_ic_vertical_align_top_black_24dp_png[39] PROGMEM = { //:Wiring
	0x5A,0x62,0x00,0x27,0x18,0x18,0x04,0x03,0x84,0xA0,0x27,0x82,0x0D,0x84,0x0B,0x86,0x09,0x88,0x0B,0x82,
	0x0E,0x82,0x0E,0x82,0x0E,0x82,0x0E,0x82,0x0E,0x82,0x0E,0x82,0x0E,0x82,0x0E,0x82,0x0E,0x82,0x07,};
	/*
	array size:   39
	image size:   24x24
	usage:
		pxs.drawIcon(x, y, icon_ic_vertical_align_top_black_24dp_png);
		pxs.cleanIcon(x, y, icon_ic_vertical_align_top_black_24dp_png);
	*/
	
	// int[] icon_FontAwesomeRegular_uF040_a = { //:Pxs
	 prog_uchar icon_FontAwesomeRegular_uF040_a[226] PROGMEM = { //:Wiring
	0x5A,0x61,0x00,0xE2,0x1B,0x1A,0x00,0x00,0x00,0x52,0x3B,0x32,0x57,0x2D,0x02,0x81,0x0E,0x3B,0x54,0x2C,
	0x01,0x83,0x0C,0x3B,0x52,0x2C,0x01,0x85,0x0B,0x3B,0x51,0x16,0x87,0x0B,0x3A,0x4E,0x2B,0x32,0x41,0x16,
	0x87,0x0C,0x3E,0x4C,0x2B,0x00,0x04,0x32,0x41,0x16,0x87,0x2C,0x4B,0x2B,0x00,0x82,0x04,0x32,0x41,0x16,
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	0x3C,0x3C,0x3C,0x3C,0x3C,0x53,};
	/*
	array size:   226
	image size:   26x27
	usage:
		pxs.drawIcon(x, y, icon_FontAwesomeRegular_uF040_a);
		pxs.cleanIcon(x, y, icon_FontAwesomeRegular_uF040_a);
	*/
	// int[] icon_FontAwesomeRegular_uF085_a = { //:Pxs
	 prog_uchar icon_FontAwesomeRegular_uF085_a[386] PROGMEM = { //:Wiring
	0x5A,0x61,0x01,0x82,0x1E,0x20,0x80,0x00,0x00,0x4D,0x0F,0x83,0x2E,0x55,0x3F,0x43,0x01,0x83,0x23,0x54,
	0x19,0x05,0x2F,0x41,0x3B,0x84,0x17,0x41,0x3F,0x1C,0x06,0x33,0x4E,0x17,0x83,0x17,0x07,0x85,0x11,0x10,
	0x82,0x04,0x33,0x4C,0x27,0x90,0x05,0x3E,0x4B,0x38,0x04,0x8F,0x18,0x4D,0x2E,0x85,0x0C,0x21,0x28,0x19,
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	0x37,0x4D,0x1B,0x82,0x2D,0x44,};
	/*
	array size:   386
	image size:   32x30
	usage:
		pxs.drawIcon(x, y, icon_FontAwesomeRegular_uF085_a);
		pxs.cleanIcon(x, y, icon_FontAwesomeRegular_uF085_a);
	*/
	// int[] icon_FontAwesomeRegular_uF0AD_a = { //:Pxs
	 prog_uchar icon_FontAwesomeRegular_uF0AD_a[195] PROGMEM = { //:Wiring
	0x5A,0x61,0x00,0xC3,0x1C,0x1C,0x00,0x00,0x00,0x51,0x3D,0x2B,0x1E,0x19,0x22,0x30,0x55,0x20,0x02,0x85,
	0x09,0x34,0x51,0x3D,0x11,0x87,0x0C,0x37,0x51,0x14,0x86,0x06,0x27,0x52,0x2D,0x85,0x01,0x1E,0x3C,0x53,
	0x10,0x85,0x2A,0x54,0x3F,0x01,0x85,0x2D,0x54,0x3C,0x86,0x2D,0x54,0x3D,0x86,0x2D,0x45,0x3B,0x1B,0x14,
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	0x3A,0x07,0x85,0x1B,0x55,0x39,0x07,0x83,0x1B,0x57,0x38,0x10,0x05,0x21,0x56,};
	/*
	array size:   195
	image size:   28x28
	usage:
		pxs.drawIcon(x, y, icon_FontAwesomeRegular_uF0AD_a);
		pxs.cleanIcon(x, y, icon_FontAwesomeRegular_uF0AD_a);
	*/
	
	
	
	// int[] icon_ic_sd_storage_black_48dp_mod_png = { //:Pxs
	 prog_uchar icon_ic_sd_storage_black_48dp_mod_png[44] PROGMEM = { //:Wiring
	0x5A,0x62,0x00,0x2C,0x24,0x24,0x86,0x03,0x83,0x08,0x95,0x08,0x97,0x06,0x98,0x05,0x99,0x04,0x9A,0x03,
	0x9B,0x02,0x9C,0x01,0xBE,0x06,0x98,0x06,0x98,0x06,0xD4,0x06,0x98,0x06,0xD4,0x06,0x98,0x06,0x98,0x06,
	0xD1,0x01,0x9C,0x01,};
	/*
	array size:   44
	image size:   36x36
	usage:
		pxs.drawIcon(x, y, icon_ic_sd_storage_black_48dp_mod_png);
		pxs.cleanIcon(x, y, icon_ic_sd_storage_black_48dp_mod_png);
	*/
	// int[] icon_ic_signal_cellular_no_sim_black_48dp_mod_png = { //:Pxs
	 prog_uchar icon_ic_signal_cellular_no_sim_black_48dp_mod_png[130] PROGMEM = { //:Wiring
	0x5A,0x62,0x00,0x82,0x24,0x24,0x81,0x03,0x80,0x23,0x83,0x1D,0x85,0x1C,0x86,0x1C,0x86,0x1C,0x9A,0x08,
	0x9A,0x08,0x9A,0x08,0x99,0x06,0x82,0x01,0x98,0x05,0x84,0x01,0x97,0x04,0x86,0x01,0x96,0x03,0x88,0x01,
	0x95,0x02,0x8A,0x01,0x94,0x02,0x83,0x06,0x82,0x01,0x93,0x02,0x83,0x06,0x83,0x01,0x92,0x02,0x83,0x06,
	0x84,0x01,0x91,0x02,0x8E,0x01,0x90,0x02,0x8F,0x01,0x8F,0x02,0x83,0x06,0x87,0x01,0x8E,0x02,0x83,0x06,
	0x88,0x01,0x8D,0x02,0x92,0x01,0x8C,0x02,0x93,0x01,0x8B,0x02,0x83,0x06,0x8B,0x01,0x8A,0x02,0x83,0x06,
	0x8C,0x01,0x89,0x02,0x83,0x06,0x8D,0x01,0x88,0x02,0x97,0x01,0x87,0x02,0x98,0x01,0x86,0x03,0x97,0x02,
	0x86,0x1C,0x86,0x1C,0x85,0x1D,0x84,0x1E,0x82,0x08,};
	/*
	array size:   130
	image size:   36x36
	usage:
		pxs.drawIcon(x, y, icon_ic_signal_cellular_no_sim_black_48dp_mod_png);
		pxs.cleanIcon(x, y, icon_ic_signal_cellular_no_sim_black_48dp_mod_png);
	*/
	
	// int[] icon_ic_expand_less_black_48dp_png = { //:Pxs
	 prog_uchar icon_ic_expand_less_black_48dp_png[54] PROGMEM = { //:Wiring
	0x5A,0x62,0x00,0x36,0x30,0x30,0x0C,0x10,0x0C,0xFF,0xE7,0xFF,0xFF,0xC3,0xFF,0xFF,0x81,0xFF,0xFF,0x00,
	0xFF,0xFE,0x00,0x7F,0xFC,0x00,0x3F,0xF8,0x18,0x1F,0xF0,0x3C,0x0F,0xE0,0x7E,0x07,0xC0,0xFF,0x03,0x81,
	0xFF,0x81,0x03,0xFF,0xC0,0x07,0xFF,0xE0,0x8F,0xFF,0xF1,0xDF,0xFF,0xFB,};
	/*
	array size:   54
	image size:   48x48
	usage:
		pxs.drawIcon(x, y, icon_ic_expand_less_black_48dp_png);
		pxs.cleanIcon(x, y, icon_ic_expand_less_black_48dp_png);
	*/
	// int[] icon_ic_expand_more_black_48dp_png = { //:Pxs
	 prog_uchar icon_ic_expand_more_black_48dp_png[54] PROGMEM = { //:Wiring
	0x5A,0x62,0x00,0x36,0x30,0x30,0x0C,0x11,0x0C,0xDF,0xFF,0xFB,0x8F,0xFF,0xF1,0x07,0xFF,0xE0,0x03,0xFF,
	0xC0,0x81,0xFF,0x81,0xC0,0xFF,0x03,0xE0,0x7E,0x07,0xF0,0x3C,0x0F,0xF8,0x18,0x1F,0xFC,0x00,0x3F,0xFE,
	0x00,0x7F,0xFF,0x00,0xFF,0xFF,0x81,0xFF,0xFF,0xC3,0xFF,0xFF,0xE7,0xFF,};
	/*
	array size:   54
	image size:   48x48
	usage:
		pxs.drawIcon(x, y, icon_ic_expand_more_black_48dp_png);
		pxs.cleanIcon(x, y, icon_ic_expand_more_black_48dp_png);
	*/
	
	// int[] icon_FontAwesomeRegular_uF021_a = { //:Pxs
	 prog_uchar icon_FontAwesomeRegular_uF021_a[144] PROGMEM = { //:Wiring
	0x5A,0x61,0x00,0x90,0x11,0x10,0x00,0x00,0x00,0x44,0x3A,0x20,0x12,0x04,0x03,0x10,0x1C,0x35,0x43,0x34,
	0x43,0x22,0x01,0x87,0x18,0x3C,0x26,0x81,0x42,0x17,0x83,0x00,0x0E,0x11,0x02,0x83,0x07,0x82,0x41,0x22,
	0x82,0x02,0x22,0x3D,0x43,0x2B,0x08,0x84,0x39,0x01,0x81,0x02,0x31,0x46,0x22,0x84,0x20,0x82,0x23,0x46,
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	0x2B,0x30,0x3E,0x45,};
	/*
	array size:   144
	image size:   16x17
	usage:
		pxs.drawIcon(x, y, icon_FontAwesomeRegular_uF021_a);
		pxs.cleanIcon(x, y, icon_FontAwesomeRegular_uF021_a);
	*/
	
	// int[] Tahoma9ba = { //:Pxs
	 prog_uchar Tahoma9ba[2321] PROGMEM = { //:Wiring
	0x5A,0x46,0x02,0x0C,0x0C,0x00,0x20,0x00,0x09,0x04,0x00,0x00,0x00,0x70,0x00,0x27,0x00,0x0E,0x03,0x00,
	0x00,0x01,0x03,0x03,0x0E,0x0E,0x16,0x16,0x00,0x25,0x00,0x55,0x0E,0x80,0x01,0x02,0x31,0x09,0x01,0x0A,
	0x31,0x44,0x0A,0x83,0x0A,0x44,0x01,0x37,0x41,0x36,0x01,0x44,0x09,0x83,0x0A,0x42,0x3B,0x17,0x31,0x09,
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	0x00,};
	// antialiased
	// array size:   2321
	// glyph height: 22
	// baseline:     12
	// range:         %',-./0123456789:?ABCEFGHIJKLMNOPRSTUXZabcdefghiklmnoprstuvwx
	/* usage:
		pxs.setFont(Tahoma9ba);
		pxs.print(x, y, "...");
	*/
